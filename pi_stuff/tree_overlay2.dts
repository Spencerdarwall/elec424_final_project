/dts-v1/;
/plugin/;

/ {
    fragment@0 {
        target-path = "/";
        __overlay__ {
            gpio_device {
                compatible = "noah,gpio";
                button-gpios = <&gpio 23 1 >;
            };
        };
    };
};